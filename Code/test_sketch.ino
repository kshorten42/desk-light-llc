#include "FastLED.h"


// How many leds in your strip?
#define NUM_LEDS 60

// For led chips like Neopixels, which have a data line, ground, and power, you just
// need to define DATA_PIN.  For led chipsets that are SPI based (four wires - data, clock,
// ground, and power), like the LPD8806 define both DATA_PIN and CLOCK_PIN
#define DATA_PIN 6
#define CLOCK_PIN 13

#define MIC_PIN 0


#define MIC_MAX 1
#define MIC_MIN 0

// Define the array of leds
CRGB leds[NUM_LEDS];




void setup() {
  Serial.begin(115200);
  Serial.println("started");



	//Set all lights to make sure all are working as expected
	FastLED.addLeds<NEOPIXEL, DATA_PIN>(leds, NUM_LEDS);
	for (int i = 0; i < NUM_LEDS; i++) 
		leds[i] = CRGB(0, 0, 255);
	FastLED.show(); 
	delay(1000); 	
	
   

    
}

void loop() {
  float sensorValue; 
  float led_to_light;
  float mic_max =100;
  // read the value from the sensor:
  sensorValue = analogRead(MIC_PIN);
  // if (sensorValue > MIC_MAX){
  //   mic_max = sensorValue;
  // }
  
  
  led_to_light = (sensorValue / mic_max) * 60.0;
  Serial.println(sensorValue, led_to_light);
  // turn the ledPin on
  for (int i = 0; i < int(led_to_light); i++) 
  
    if (numLe)
		leds[i] = CRGB(0, 255-2*i, 0+2*i);
  FastLED.show();
  // stop the program for <sensorValue> milliseconds:
  //delay(sensorValue);
    

  // turn the ledPin off:
  for (int i = 0; i < NUM_LEDS; i++) 
  leds[i] = CRGB::Black;
  leds[i].fadeToBlackBy(60);
  FastLED.show();
  // stop the program for for <sensorValue> milliseconds:
 
 // delay(sensorValue);
  
  
  
  
    
}
